## configs/gk6323v100c_defconfig
```kconfig
CONFIG_ARM64=y
CONFIG_ARCH_HISI=y
CONFIG_ARCH_HISTB=y
# GK6323V100C = Hi3798MV200H
CONFIG_ARCH_HI3798MV2X=y
CONFIG_ARCH_HI3798MV200=y
CONFIG_SMP=y
CONFIG_NR_CPUS=4
CONFIG_CPU_CORTEX_A53=y
# 内存和MMU
CONFIG_MMU=y
CONFIG_ARM64_VA_BITS_48=y
CONFIG_ARM64_PA_BITS_48=y
# 基础设备树，内置DTB
CONFIG_USE_BUILTIN_DTB=y
CONFIG_BUILTIN_DTB="hi3798mv200h"
CONFIG_OF=y
CONFIG_OF_FLATTREE=y
# U-Boot启动支持
CONFIG_UEFI_API=n
CONFIG_ARM64_BOOTPARAM_UIMAGE=y
# 控制台串口
CONFIG_SERIAL_AMBA_PL011=y
CONFIG_SERIAL_AMBA_PL011_CONSOLE=y
CONFIG_SERIAL_CORE=y
CONFIG_SERIAL_CORE_CONSOLE=y
# 模块支持（解决原内核无/proc/modules问题）
CONFIG_MODULES=y
CONFIG_MODULE_UNLOAD=y
CONFIG_MODULE_FORCE_UNLOAD=y
CONFIG_MODVERSIONS=y
CONFIG_MODULE_SRCVERSION_ALL=y
# 块设备
CONFIG_BLOCK=y
CONFIG_BLK_DEV=y
CONFIG_MMC=y
CONFIG_MMC_SDHCI=y
CONFIG_MMC_SDHCI_PLTFM=y
CONFIG_MMC_DW=y
CONFIG_MMC_DW_HISI=y
# eMMC支持
CONFIG_MMC_BLOCK=y
CONFIG_MMC_BLOCK_MINORS=32
# 文件系统
CONFIG_EXT4_FS=y
CONFIG_EXT4_FS_POSIX_ACL=y
CONFIG_EXT4_FS_SECURITY=y
CONFIG_F2FS_FS=m
CONFIG_FS_POSIX_ACL=y
CONFIG_TMPFS=y
CONFIG_PROC_FS=y
CONFIG_SYSFS=y
CONFIG_DEVTMPFS=y
CONFIG_DEVTMPFS_MOUNT=y
# 网络支持
CONFIG_NET=y
CONFIG_PACKET=y
CONFIG_INET=y
CONFIG_NETDEVICES=y
CONFIG_HISILICON_NET=y
CONFIG_GK_ETH=y
# USB控制器驱动（必须内置，否则启动找不到存储）
CONFIG_USB=y
CONFIG_USB_EHCI_HCD=y
CONFIG_USB_EHCI_HISILICON=y
CONFIG_USB_OHCI_HCD=y
CONFIG_USB_OHCI_HISILICON=y
CONFIG_USB_XHCI_HCD=m
CONFIG_USB_XHCI_PLATFORM=m
CONFIG_USB_STORAGE=m
# 音频：ALSA核心 + 板载AIAO + USB音频全支持
CONFIG_SOUND=y
CONFIG_SND=y
CONFIG_SND_TIMER=y
CONFIG_SND_PCM=y
CONFIG_SND_HWDEP=m
CONFIG_SND_RAWMIDI=m
CONFIG_SND_SEQUENCER=m
CONFIG_SND_SEQ_DUMMY=m
CONFIG_SND_OSSEMUL=y
CONFIG_SND_MIXER_OSS=m
CONFIG_SND_PCM_OSS=m
# 海思板载音频
CONFIG_SND_SOC=y
CONFIG_SND_SOC_HISTB=y
CONFIG_SND_SOC_HISTB_AIAO=y
CONFIG_SND_SOC_HISTB_I2S=y
# USB音频核心（必须开启，这是本次要补的功能）
CONFIG_SND_USB=y
CONFIG_SND_USB_AUDIO=m
CONFIG_SND_USB_UA10=m
CONFIG_SND_USB_LINE6=m
CONFIG_SND_USB_CAIAQ=m
CONFIG_SND_USB_HIFACE=m
# 高分辨率定时器（音频必需）
CONFIG_HIGH_RES_TIMERS=y
CONFIG_NO_HZ_IDLE=y
CONFIG_HZ_100=y
CONFIG_PREEMPT=y
# 内核压缩：无压缩，对齐原boot.img的-C none
CONFIG_KERNEL_GZIP=n
CONFIG_KERNEL_LZ4=n
CONFIG_KERNEL_LZMA=n
CONFIG_KERNEL_NONE=y
# CMA和DMA
CONFIG_CMA=y
CONFIG_CMA_SIZE_MBYTES=64
CONFIG_ZONE_DMA=y
CONFIG_ZONE_DMA32=y
CONFIG_DMA_CMA=y
# 必要的驱动
CONFIG_HAVE_CLK=y
CONFIG_CLKDEV_LOOKUP=y
CONFIG_COMMON_CLK=y
CONFIG_CLK_HISI=y
CONFIG_PINCTRL=y
CONFIG_PINCTRL_HISTB=y
CONFIG_GPIO_HISI=y
CONFIG_GPIO_SYSFS=y
CONFIG_WATCHDOG=y
CONFIG_HISI_WATCHDOG=y
CONFIG_RTC_CLASS=y
CONFIG_RTC_DRV_HISI=y
CONFIG_PM=y
CONFIG_PM_SLEEP=y
CONFIG_NETWORK_FILESYSTEMS=y
CONFIG_NFS_FS=m
CONFIG_CIFS=m
CONFIG_SMB_SERVER=m
```
